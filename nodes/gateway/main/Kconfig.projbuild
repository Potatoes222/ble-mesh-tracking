## nodes/gateway/main/Kconfig.projbuild
```kconfig
menu "BMT Gateway"

    config BMT_WIFI_SSID
        string "WiFi SSID"
        default ""
        help
            SSID of the Wi-Fi network the gateway connects to.

    config BMT_WIFI_PASS
        string "WiFi Password"
        default ""
        help
            WPA2 password for the Wi-Fi network. Leave empty for open network.

    config BMT_TB_IP
        string "ThingsBoard IP address"
        default "192.168.1.113"
        help
            LAN IP of the ThingsBoard broker (used to build mqtts URI).

    config BMT_TB_CN
        string "ThingsBoard server cert CN"
        default "bmt-tb.local"
        help
            Common Name in the SubjectAltName of the TB server certificate.
            Used for TLS hostname verification.

    config BMT_TB_GATEWAY_TOKEN
        string "ThingsBoard gateway access token"
        default ""
        help
            Access token generated in ThingsBoard UI for the gateway device.
            Do NOT commit real tokens; enter it via `idf.py menuconfig` locally.

endmenu
```
